## Kconfig.shield
```kconfig
# Copyright (c) 2020 The ZMK Contributors
# SPDX-License-Identifier: MIT

config SHIELD_SATH65
    def_bool $(shields_list_contains,sath65)
```

## sath65/Kconfig.defconfig
```kconfig
# Copyright (c) 2020 The ZMK Contributors
# SPDX-License-Identifier: MIT

if SHIELD_SATH65

config ZMK_KEYBOARD_NAME
    default "sath65"

endif
```
